## west.yml
```yaml
# Copyright (c) 2026 Eoin Jordan
# SPDX-License-Identifier: Apache-2.0
#
#   west init -m https://github.com/eoinjordan/executorch-zephyr-arducam-pico4ML-BLE ws
#   cd ws && west update

manifest:
  remotes:
    - name: zephyrproject-rtos
      url-base: https://github.com/zephyrproject-rtos
    - name: pytorch
      url-base: https://github.com/pytorch

  projects:
    - name: zephyr
      remote: zephyrproject-rtos
      revision: v4.4.0
      import:
        name-allowlist:
          - hal_rpi_pico
          - cmsis
          - cmsis_6
          - cmsis-nn

    - name: executorch
      remote: pytorch
      revision: v1.5.1
      path: modules/lib/executorch
      submodules: true

  self:
    path: executorch-zephyr-arducam-pico4ML-BLE
```
